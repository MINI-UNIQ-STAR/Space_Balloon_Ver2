## zephyrRTOS/zephyr_app/boards/st/space_balloon_ver2/Kconfig.defconfig
```kconfig
# Space Balloon Ver2 Board Definitions

if BOARD_SPACE_BALLOON_VER2

config BOARD
	default "space_balloon_ver2"

config BOARD_SPACE_BALLOON_VER2
	def_bool y

endif # BOARD_SPACE_BALLOON_VER2
```

## zephyrRTOS/zephyr_app/boards/st/space_balloon_ver2/space_balloon_ver2_defconfig
```kconfig
# Space Balloon Ver2 - Default Configuration
# STM32G431CBU6 (Cortex-M4F, 128KB Flash, 32KB RAM)

# MCU
CONFIG_SOC_SERIES_STM32G4X=y
CONFIG_SOC_STM32G431XX=y

# Clock (170MHz)
CONFIG_SYS_CLOCK_HW_CYCLES_PER_SEC=170000000
CONFIG_CLOCK_STM32_SYSCLK_SRC_PLL=y
CONFIG_CLOCK_STM32_PLL_SRC_HSE=y
CONFIG_CLOCK_STM32_HSE_CLOCK=24000000

# Console
CONFIG_SERIAL=y
CONFIG_UART_INTERRUPT_DRIVEN=y
CONFIG_CONSOLE=y
CONFIG_UART_CONSOLE=y

# Logging
CONFIG_LOG=y
CONFIG_LOG_DEFAULT_LEVEL=3
CONFIG_LOG_BACKEND_UART=y

# GPIO
CONFIG_GPIO=y

# I2C
CONFIG_I2C=y
CONFIG_I2C_STM32=y
CONFIG_I2C_STM32_INTERRUPT=y

# PWM
CONFIG_PWM=y
CONFIG_PWM_STM32=y

# ADC
CONFIG_ADC=y
CONFIG_ADC_STM32=y

# RTOS
CONFIG_MULTITHREADING=y
CONFIG_NUM_COOP_PRIORITIES=16
CONFIG_NUM_PREEMPT_PRIORITIES=16

# Heap
CONFIG_HEAP_MEM_POOL_SIZE=2048

# Debug
CONFIG_DEBUG=y
CONFIG_ASSERT=y

# Watchdog (optional)
# CONFIG_WATCHDOG=y
# CONFIG_WDT_STM32=y
```

## zephyrRTOS/zephyr_port/boards/arm/stm32g431cbu6/Kconfig.board
```kconfig
config BOARD_STM32G431CBU6
	bool "STM32G431CBU6 custom board"
	depends on SOC_SERIES_STM32G4X
```

## zephyrRTOS/zephyr_port/boards/arm/stm32g431cbu6/stm32g431cbu6_defconfig
```kconfig
# STM32G431CBU6 custom board defaults
CONFIG_GPIO=y
CONFIG_SERIAL=y
CONFIG_CONSOLE=y
CONFIG_UART_CONSOLE=y
```

## zephyr_app/boards/st/space_balloon_ver2/Kconfig.board
```kconfig
# Space Balloon Ver2 Board Configuration

config BOARD_SPACE_BALLOON_VER2
	bool "Space Balloon Ver2 Radiosonde"
	depends on SOC_STM32G431XX
	select SOC_STM32G431XX
	help
	  Space Balloon high-altitude radiosonde based on STM32G431CBU6.
	  
	  Features:
	  - Cortex-M4F @ 170MHz
	  - 128KB Flash, 32KB RAM
	  - 9x I2C/UART sensors
	  - 2x PWM heaters
	  - Telemetry output via UART3
```

## zephyr_port/boards/arm/stm32g431cbu6/Kconfig.defconfig
```kconfig
if BOARD_STM32G431CBU6

config GPIO
	default y

config SERIAL
	default y

config UART_CONSOLE
	default y

config CONSOLE
	default y

config CLOCK_CONTROL
	default y

endif
```
