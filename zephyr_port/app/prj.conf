## prj.conf
```kconfig
CONFIG_SERIAL=y
CONFIG_CONSOLE=y
CONFIG_UART_CONSOLE=y

CONFIG_LOG=y
CONFIG_LOG_DEFAULT_LEVEL=3
CONFIG_PINCTRL=y
```

## src/main.c
```c
#include <zephyr/kernel.h>
#include <zephyr/logging/log.h>
#include <zephyr/sys/printk.h>

LOG_MODULE_REGISTER(space_balloon_zephyr, LOG_LEVEL_INF);

int main(void)
{
    printk("Hello from Zephyr Space_Balloon_Ver2\\n");
    LOG_INF("Space_Balloon_Ver2 Zephyr skeleton booted");

    while (1) {
        LOG_INF("Periodic heartbeat: app alive");
        k_msleep(1000);
    }

    return 0;
}
```
