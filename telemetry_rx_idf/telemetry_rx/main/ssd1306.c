#include "ssd1306.h"
#include <string.h>

#define SSD1306_I2C_ADDR 0x3C

static i2c_port_t _i2c_num;
static uint8_t _display_buffer[8][128]; // 8 pages, 128 columns

// Minimal 5x8 font (printable ASCII: ' ' to '~')
static const uint8_t font5x8[] = {
    0x00, 0x00, 0x00, 0x00, 0x00, 0x00, 0x00, 0x5f, 0x00, 0x00, 0x00, 0x07,
    0x00, 0x07, 0x00, 0x14, 0x7f, 0x14, 0x7f, 0x14, 0x24, 0x2a, 0x7f, 0x2a,
    0x12, 0x23, 0x13, 0x08, 0x64, 0x62, 0x36, 0x49, 0x55, 0x22, 0x50, 0x00,
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    0x08, 0x00, 0x02, 0x01, 0x02, 0x04, 0x02};

static void i2c_write_cmd(uint8_t cmd) {
  i2c_cmd_handle_t handle = i2c_cmd_link_create();
  i2c_master_start(handle);
  i2c_master_write_byte(handle, (SSD1306_I2C_ADDR << 1) | I2C_MASTER_WRITE,
                        true);
  i2c_master_write_byte(handle, 0x00, true);
  i2c_master_write_byte(handle, cmd, true);
  i2c_master_stop(handle);
  i2c_master_cmd_begin(_i2c_num, handle, 1000 / portTICK_PERIOD_MS);
  i2c_cmd_link_delete(handle);
}

void ssd1306_init(i2c_port_t i2c_num, int sda_pin, int scl_pin) {
  _i2c_num = i2c_num;
  i2c_config_t conf = {
      .mode = I2C_MODE_MASTER,
      .sda_io_num = sda_pin,
      .sda_pullup_en = GPIO_PULLUP_ENABLE,
      .scl_io_num = scl_pin,
      .scl_pullup_en = GPIO_PULLUP_ENABLE,
      .master.clk_speed = 400000,
  };
  i2c_param_config(i2c_num, &conf);
  i2c_driver_install(i2c_num, conf.mode, 0, 0, 0);

  i2c_write_cmd(0xAE); // Display Off
  i2c_write_cmd(0x20); // Set Memory Addressing Mode
  i2c_write_cmd(0x00); // Horizontal Addressing Mode
  i2c_write_cmd(0xC8); // Set COM Output Scan Direction
  i2c_write_cmd(0x8D); // re-map
  i2c_write_cmd(0x40); // Set start line
  i2c_write_cmd(0x81); // Set charge pump
  i2c_write_cmd(0x14);
  i2c_write_cmd(0xAF); // Display On
}

void ssd1306_clear(void) {
  memset(_display_buffer, 0, sizeof(_display_buffer));
}

void ssd1306_print(uint8_t page, uint8_t col, const char *str) {
  if (page >= 8)
    return;
  while (*str) {
    if (col + 5 >= 128)
      break;
    char c = *str;
    if (c < ' ' || c > '~')
      c = '?';
    const uint8_t *glyph = &font5x8[(c - ' ') * 5];
    for (int i = 0; i < 5; i++) {
      _display_buffer[page][col++] = glyph[i];
    }
    _display_buffer[page][col++] = 0x00; // 1 pixel spacing
    str++;
  }
}

void ssd1306_show(void) {
  for (int p = 0; p < 8; p++) {
    i2c_write_cmd(0xB0 + p);
    i2c_write_cmd(0x00);
    i2c_write_cmd(0x10);

    i2c_cmd_handle_t handle = i2c_cmd_link_create();
    i2c_master_start(handle);
    i2c_master_write_byte(handle, (SSD1306_I2C_ADDR << 1) | I2C_MASTER_WRITE,
                          true);
    i2c_master_write_byte(handle, 0x40, true);
    i2c_master_write(handle, _display_buffer[p], 128, true);
    i2c_master_stop(handle);
    i2c_master_cmd_begin(_i2c_num, handle, 1000 / portTICK_PERIOD_MS);
    i2c_cmd_link_delete(handle);
  }
}
